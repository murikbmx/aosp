## drivers/kernelsu/Kconfig
```kconfig
menu "KernelSU"

config KSU
tristate "KernelSU function support"
depends on KPROBES
default y

config KSU_DEBUG
bool "KernelSU debug mode"
depends on KSU
default n

config KSU_NEXT
bool "Enable KernelSU Next"
default y

config KSU_SUSFS
bool "Enable KSU SUSFS Integration"
depends on SUSFS
default y

endmenu
```

## drivers/susfs/Kconfig
```kconfig
config SUSFS
    bool "Sultan's Universal Suhide File System"
    default y
    help
      Enable support for SUSFS, which allows hiding files and directories 
      from user-space processes.
```
